## Kconfig
```kconfig
# Kconfig - general configuration options

#
# Copyright (c) 2018 amine
#
# SPDX-License-Identifier: Apache-2.0
#
mainmenu "Application Configuration"

source "components/Kconfig"

source "subsys/Kconfig"
```

## components/Kconfig
```kconfig
# Kconfig - comm configuration options

#
# Copyright (c) 2018 amine
#
# SPDX-License-Identifier: Apache-2.0
#


menu "Comm Options"


endmenu
```

## subsys/cjson/Kconfig
```kconfig
# Kconfig - cjson module options
#
# Copyright (c) 2018 Noitom
#
# SPDX-License-Identifier: Apache-2.0
#

config CJSON
	bool "cJSON"
	default n
```
